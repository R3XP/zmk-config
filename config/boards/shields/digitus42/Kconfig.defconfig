## config/boards/shields/digitus42/Kconfig.defconfig
```kconfig
if SHIELD_DIGITUS42_LEFT

config ZMK_KEYBOARD_NAME
    default "Digitus 42"

config ZMK_SPLIT_BLE_ROLE_CENTRAL
    default y

endif

if SHIELD_DIGITUS42_LEFT || SHIELD_DIGITUS42_RIGHT

config ZMK_SPLIT
    default y

endif
```

## config/boards/shields/digitus42/Kconfig.shield
```kconfig
config SHIELD_DIGITUS42_LEFT
    def_bool $(shields_list_contains,digitus42_left)

config SHIELD_DIGITUS42_RIGHT
    def_bool $(shields_list_contains,digitus42_right)
```
