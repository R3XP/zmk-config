
/*
 * Copyright (c) 2020 The ZMK Contributors
 *
 * SPDX-License-Identifier: MIT
 */

#include <behaviors.dtsi>
#include <dt-bindings/zmk/keys.h>
#include <dt-bindings/zmk/bt.h>
#include <dt-bindings/zmk/outputs.h>

#define DE_A        A                  // A
#define DE_B        B                  // B
#define DE_C        C                  // C
#define DE_D        D                  // D
#define DE_E        E                  // E
#define DE_F        F                  // F
#define DE_G        G                  // G
#define DE_H        H                  // H
#define DE_I        I                  // I
#define DE_J        J                  // J
#define DE_K        K                  // K
#define DE_L        L                  // L
#define DE_M        M                  // M
#define DE_N        N                  // N
#define DE_O        O                  // O
#define DE_P        P                  // P
#define DE_Q        Q                  // Q
#define DE_R        R                  // R
#define DE_S        S                  // S
#define DE_T        T                  // T
#define DE_U        U                  // U
#define DE_V        V                  // V
#define DE_W        W                  // W
#define DE_X        X                  // X
#define DE_Y        Z                  // Y
#define DE_Z        Y                  // Z

#define DE_DOT      PERIOD             // .
#define DE_COMM     COMMA              // ,
#define DE_MINS     SLASH              // -

#define DE_AE       SINGLE_QUOTE       // Ä
#define DE_OE       SEMICOLON          // Ö
#define DE_UE       LEFT_BRACKET       // Ü
#define DE_SS       MINUS              // ß

#define DE_CIRC     GRAVE             // ^ (dead)
#define DE_EXLM     LS(NUMBER_1)      // !
#define DE_DQUO     LS(NUMBER_2)      // "
#define DE_DLR      LS(NUMBER_4)      // $
#define DE_AMPR     LS(NUMBER_6)      // &
#define DE_PERC     LS(NUMBER_5)      // %

#define DE_PIPE     RA(DE_LABK)       // |
#define DE_AT       RA(DE_Q)          // @
#define DE_TILD     RA(DE_PLUS)       // ~
#define DE_EURO     RA(DE_E)          // €
#define DE_PLUS     RIGHT_BRACKET     // +
#define DE_ASTR     LS(DE_PLUS)       // *
#define DE_DEG      LS(DE_CIRC)       // °
#define DE_SECT     LS(NUMBER_3)      // §

#define DE_LPRN     LS(NUMBER_8)      // (
#define DE_RPRN     LS(NUMBER_9)      // )
#define DE_LCBR     RA(NUMBER_7)      // {
#define DE_RCBR     RA(NUMBER_0)      // }
#define DE_LBRC     RA(NUMBER_8)      // [
#define DE_RBRC     RA(NUMBER_9)      // ]
#define DE_LABK     NON_US_BACKSLASH  // <
#define DE_RABK     LS(DE_LABK)       // >
#define DE_ACUT     EQUAL             // ´ (dead)
#define DE_HASH     NON_US_HASH       // #
#define DE_COLN     LS(DE_DOT)        // :
#define DE_SLSH     LS(NUMBER_7)      // /
#define DE_EQL      LS(NUMBER_0)      // =
#define DE_QUES     LS(DE_SS)         // ?
#define DE_GRV      LS(DE_ACUT)       // ` (dead)
#define DE_QUOT     LS(DE_HASH)       // '
#define DE_SCLN     LS(DE_COMM)       // ;
#define DE_UNDS     LS(DE_MINS)       // _
#define DE_BSLS     RA(DE_SS)         // (backslash)


#define DEFAULT  0
#define SYMBOL   3
#define NAV      5
#define CONTROL  7
#define STENO    9
#define LOCK     10

#define ALL_BUT_STENO   0 1 2 3 4 5 6 7 8 10
#define ALL             ALL_BUT_STENO 9


#define COMBO(NAME, BINDINGS, KEYPOS, TERM, LAYERS) \
        combo_##NAME { \
            timeout-ms = <TERM>; \
            bindings = <BINDINGS>; \
            key-positions = <KEYPOS>; \
            layers = <LAYERS>; \
        };

        
#define DANCE2(NAME, LABEL, B1, B2, TERM) \
        d_##NAME: ##NAME { \
            compatible = "zmk,behavior-tap-dance"; \
            label = ##LABEL; \
            #binding-cells = <0>; \
            tapping-term-ms = <TERM>; \
            bindings = <B1>, <B2>; \
        };
        

#define MAC02(NAME, LABEL, B1, B2, WAIT, TAP) \
        m_##NAME: ##NAME {  \
            label = ##LABEL; \
            compatible = "zmk,behavior-macro"; \
            #binding-cells = <0>; \
            wait-ms = <WAIT>; \
            tap-ms = <TAP>; \
            bindings \
                = <B1> \
                , <B2>; \
        };

// | SW0  | SW1  | SW2  | SW3  | SW4  | SW5  |                 | SW6  | SW7  | SW8  | SW9  | SW10 | SW11 |
// | SW12 | SW13 | SW14 | SW15 | SW16 | SW17 |                 | SW18 | SW19 | SW20 | SW21 | SW22 | SW23 |
// | SW24 | SW25 | SW26 | SW27 | SW28 | SW29 |                 | SW30 | SW31 | SW32 | SW33 | SW34 | SW35 |
// |      |      |      |      | SW36 | SW37 | SW38 |   | SW39 | SW40 | SW41 |      |      |      |      |



/ {
    macros {
        plov_on: ploveron {
            label = "start_plover";
            compatible = "zmk,behavior-macro"; 
            #binding-cells = <0>; 
            wait-ms = <20>; 
            tap-ms = <20>; 
            bindings
                = <&macro_press &kp C>
                , <&macro_tap &kp T &kp G &tog STENO>
                , <&macro_release &kp C>
                ;
        };
        plov_off: ploveroff {
            label = "stop_plover";
            compatible = "zmk,behavior-macro"; 
            #binding-cells = <0>; 
            wait-ms = <20>; 
            tap-ms = <20>; 
            bindings
                = <&macro_press &kp C>
                , <&macro_tap &kp T &kp R &tog STENO>
                , <&macro_release &kp C>
                ;
        };
        MAC02(tick, "tick", &kp DE_GRV,  &kp SPACE, 32, 32)
        MAC02(circ, "circ", &kp DE_CIRC, &kp SPACE, 32, 32)
    };



    combos {
        compatible = "zmk,combos";
        COMBO(go_home, &to DEFAULT, 15 16 19 20,      60, ALL_BUT_STENO)
        COMBO(go_lock, &to LOCK, 8 36 37 38 39 40 41, 50, ALL_BUT_STENO)
        COMBO(go_ctrl, &to CONTROL, 0 12 24,          50, ALL)
    };



    behaviors {
        skq: sticky_key_quick_release {
            compatible = "zmk,behavior-sticky-key";
            label = "STICKY_KEY_QUICK_RELEASE";
            #binding-cells = <1>;
            bindings = <&kp>;
            release-after-ms = <1000>;
            quick-release;
        };
        DANCE2(esctab, "esctab", &kp ESC   , &kp TAB   , 300)
        DANCE2(altgui, "altgui", &kp LALT  , &kp LGUI  , 300)
        DANCE2(symbol, "symbol", &mo SYMBOL, &to SYMBOL, 300)
        DANCE2(nav,    "nav"   , &mo NAV   , &to NAV   , 300)
    };




    
    conditional_layers {
        compatible = "zmk,conditional-layers";
        raise_default {
            if-layers  = <1>;
            then-layer = <2>;
        };
        raise_nav {
            if-layers  = <NAV 1>;
            then-layer = <6>;
        };
    };



    keymap { 
        compatible = "zmk,keymap";



        layer_default {
            bindings = <
   &d_esctab    &kp J   &kp D  &kp U              &kp A               &kp X                   &kp P       &kp H       &kp L      &kp M     &kp W    &kp BSPC
   &kp LCTRL    &kp C   &kp T  &kp I              &kp E               &kp O                   &kp B       &kp N       &kp R      &kp S     &kp G    &kp Q
   &kp LSHIFT   &kp F   &kp V  &kp LEFT_BRACKET   &kp SINGLE_QUOTE    &kp SEMI                &kp Z       &kp Y       &kp COMMA  &kp DOT   &kp K    &kp J
                               &mo NAV            &kp SPACE           &mo SYMBOL              &kp LSHFT   &mo 1       &d_altgui
            >;
        };



        raise {
            bindings = <
  &trans   &trans   &trans   &trans   &trans   &trans           &trans   &trans   &trans   &trans   &trans   &trans
  &trans   &trans   &trans   &trans   &trans   &trans           &trans   &trans   &trans   &trans   &trans   &trans
  &trans   &trans   &trans   &trans   &trans   &trans           &trans   &trans   &trans   &trans   &trans   &trans
                             &trans   &trans   &trans           &trans   &trans   &trans
            >;
        };


        
        layer_default_raised {
            bindings = <
  &trans   &trans   &trans            &kp DE_UE   &kp DE_AE   &trans           &trans      &trans   &trans   &trans     &trans      &trans
  &trans   &trans   &kp LC(LA(TAB))   &trans      &kp RET     &kp DE_OE        &trans      &trans   &trans   &kp DE_SS  &skq LSHFT  &trans
  &trans   &trans   &trans            &trans      &trans      &trans           &trans      &trans   &trans   &trans     &trans      &trans
                                      &trans      &trans      &trans           &trans      &trans   &trans
            >;
        };



        layer_symbol {
            bindings = <
    &trans   &trans        &kp DE_UNDS   &kp DE_LBRC  &kp DE_RBRC   &m_circ                    &kp DE_EXLM  &kp DE_LABK   &kp DE_RABK   &kp DE_EQL   &kp DE_AMPR   &kp BSPC
    &none    &kp DE_BSLS   &kp DE_SLSH   &kp DE_LCBR  &kp DE_RCBR   &kp DE_ASTR                &kp DE_QUES  &kp DE_LPRN   &kp DE_RPRN   &kp DE_MINS  &kp DE_COLN   &kp DE_AT
    &trans   &kp DE_HASH   &kp DE_DLR    &kp DE_PIPE  &kp DE_TILD   &m_tick                    &kp DE_PLUS  &kp DE_PERC   &kp DE_DQUO   &kp DE_QUOT  &kp DE_SCLN   &kp LCTRL
                                         &trans       &kp LCTRL     &mo 1                      &kp RET      &trans        &kp RALT
            >;
        };

        
        layer_symbol_raised {
            bindings = <
  &trans   &trans   &trans   &trans   &trans   &trans           &trans   &trans   &trans   &trans   &trans   &trans
  &trans   &trans   &trans   &trans   &trans   &trans           &trans   &trans   &trans   &trans   &trans   &trans
  &trans   &trans   &trans   &trans   &trans   &trans           &trans   &trans   &trans   &trans   &trans   &trans
                             &trans   &trans   &trans           &trans   &trans   &trans
            >;
        };



        layer_navigation {
            bindings = <
    &kp TAB      &kp LS(TAB)  &kp BSPC    &kp UP         &kp DEL       &kp PRCNT              &kp CARET    &kp N7    &kp N8  &kp N9  &kp RPAR   &kp BSPC
    &kp LCTRL    &kp HOME     &kp LEFT    &kp DOWN       &kp RIGHT     &kp END                &kp LALT     &kp N4    &kp N5  &kp N6  &kp BSLH  &kp GRAVE
    &kp LSHFT    &kp LCTRL    &kp LCTRL   &kp LCTRL      &kp ENTER     &kp LCTRL              &kp UNDER    &kp N1    &kp N2  &kp N3  &kp PIPE  &kp TILDE
                                          &d_altgui      &trans        &to 1                  &kp RET      &trans    &kp N0
            >;
        };


        
        layer_nav_raised {
            bindings = <
  &trans   &trans   &trans   &trans   &trans   &trans           &trans   &kp F7  &kp F8  &kp F9  &trans   &trans
  &trans   &trans   &trans   &trans   &trans   &trans           &trans   &kp F4  &kp F5  &kp F6  &trans   &trans
  &trans   &trans   &trans   &trans   &trans   &trans           &trans   &kp F1  &kp F2  &kp F3  &trans   &trans
                             &trans   &trans   &trans           &trans   &trans   &trans
            >;
        };



        layer_control {
            bindings = <
 &trans       &trans  &to DEFAULT &bt BT_CLR    &bt BT_PRV    &bt BT_NXT            &bt BT_PRV    &bt BT_NXT    &bt BT_CLR       &trans       &trans  &trans
 &reset       &trans  &trans      &trans  &out OUT_USB  &out OUT_BLE          &out OUT_BLE  &out OUT_USB        &trans       &to STENO       &trans  &reset
 &trans  &bootloader  &trans      &trans        &trans        &trans                &trans  &bt BT_SEL 0  &bt BT_SEL 1 &bt BT_SEL 2  &bootloader  &trans
                                  &trans        &trans        &trans                &trans        &trans        &trans
            >;
        };



        layer_qwertz {
            bindings = <
   &kp TAB   &kp Q &kp W &kp E &kp R &kp T   &kp Z &kp U  &kp I     &kp O   &kp P    &kp BSPC
   &kp LCTRL &kp A &kp S &kp D &kp F &kp G   &kp H &kp J  &kp K     &kp L   &kp SEMI &kp SQT
   &kp LSHFT &kp Y &kp X &kp C &kp V &kp B   &kp N &kp M  &kp COMMA &kp DOT &kp FSLH &kp ESC
                  &kp LGUI &mo 1 &kp SPACE   &kp RET &mo 2 &kp RALT
            >;
        };



        layer_steno {
            bindings = <
  &trans   &kp X    &kp X    &kp X    &kp X    &kp X            &plov_off &kp X      &kp X    &kp X    &kp X    &kp X 
  &trans   &trans   &trans   &trans   &trans   &trans           &trans    &trans     &trans   &trans   &trans   &trans
  &trans   &trans   &trans   &trans   &trans   &trans           &trans    &trans     &trans   &trans   &trans   &trans
                             &trans   &kp A    &kp D            &kp L     &kp M      &trans
            >;
        };



        layer_lock {
            bindings = <
  &none   &none   &none   &none   &none   &none           &none   &none   &none   &none   &none   &none
  &none   &none   &none   &none   &none   &none           &none   &none   &none   &none   &none   &none
  &none   &none   &none   &none   &none   &none           &none   &none   &none   &none   &none   &none
                          &none   &none   &none           &none   &none   &none
            >;
        };

    };
};
